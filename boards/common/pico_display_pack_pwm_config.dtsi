&pwm {
    pinctrl-0 = <&pwm_default>;
    pinctrl-names = "default";

    status = "okay";

    divider-frac-2 = <15>;
    divider-int-2 = <255>;

    divider-frac-3 = <15>;
    divider-int-3 = <255>;

    divider-frac-4 = <15>;
    divider-int-4 = <255>;
};

&pinctrl {
    pwm_default: pwm_default {
        group1 {
            pinmux = <PWM_4B_P25>, <PWM_2A_P20>, <PWM_3A_P6>, <PWM_3B_P7>, <PWM_4A_P8>;
            drive-strength = <2>;
            slew-rate = <1>;
            bias-pull-up;
        };
    };
};
